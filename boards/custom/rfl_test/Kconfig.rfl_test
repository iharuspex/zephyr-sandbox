## boards/custom/rocket_flight_logger/board.yml
```yaml
board:
  name: rocket_flight_logger
  vendor: custom
  socs:
    - name: stm32f103xb
```

## drivers/display/sitronix/st7789v_spi/Kconfig
```kconfig
# ST7789V_SPI display driver configuration options

menuconfig ST7789V_SPI
	bool "ST7789V_SPI display driver"
	depends on SPI
	help
	  Enable driver for ST7789V_SPI display driver.

choice ST7789V_SPI_PIXEL_FORMAT
	prompt "Color pixel format"
	default ST7789V_SPI_RGB565
	depends on ST7789V_SPI
	help
	  Specify the color pixel format for the ST7789V_SPI display controller.

config ST7789V_SPI_RGB888
	bool "RGB888"

config ST7789V_SPI_RGB565
	bool "RGB565"

endchoice
```

## west.yml
```yaml
manifest:
  remotes:
    - name: zephyrproject-rtos
      url-base: https://github.com/zephyrproject-rtos

  projects:
    - name: zephyr
      remote: zephyrproject-rtos
      revision: v4.1.0
      west-commands: scripts/west-commands.yml
      import:
        path-prefix: deps/zephyr
        name-allowlist:
          - cmsis
          - hal_nordic
          - hal_stm32
```
