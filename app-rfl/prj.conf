## CMakeLists.txt
```
cmake_minimum_required(VERSION 3.13.1)

if (NOT DEFINED ENV{BOARD})
    set(BOARD "rocket_flight_logger")
endif()

find_package(Zephyr REQUIRED HINTS $ENV{ZEPHYR_BASE})

project(rfl-firmware LANGUAGES C)

target_sources(app PRIVATE
    src/main.c
    src/at_client/at_client.c
)

target_include_directories(app PRIVATE include)
```

## sample.yaml
```
# This file is provided so that the application can be compiled using Twister,
# the Zephyr testing tool. In this file, multiple combinations can be specified,
# so that you can easily test all of them locally or in CI.
sample:
  description: rfl_firmware
  name: rfl_firmware
common:
  build_only: true
  integration_platforms:
    - rocket_flight_logger
tests:
  app.default: {}
  app.debug:
    extra_overlay_confs:
      - debug.conf
```

## prj.conf
```kconfig
CONFIG_PICOLIBC=y
CONFIG_NEWLIB_LIBC=n

CONFIG_SENSOR=y
CONFIG_GPIO=y

CONFIG_MAIN_STACK_SIZE=1024
CONFIG_IDLE_STACK_SIZE=256
CONFIG_SYSTEM_WORKQUEUE_STACK_SIZE=512
CONFIG_HEAP_MEM_POOL_SIZE=0

CONFIG_UART_INTERRUPT_DRIVEN=y
CONFIG_UART_LINE_CTRL=y

CONFIG_REGULATOR=y
```

## debug.conf
```kconfig
CONFIG_DEBUG_OPTIMIZATIONS=y

CONFIG_CONSOLE=y
CONFIG_UART_CONSOLE=y

CONFIG_LOG=y
# CONFIG_LOG_MODE_IMMEDIATE=y
CONFIG_LOG_MODE_MINIMAL=y
CONFIG_LOG_DEFAULT_LEVEL=3

CONFIG_PRINTK=y
```

## boards/rocket_flight_logger.overlay
```dts
/ {
    leds {
		compatible = "gpio-leds";
		led: led {
			gpios = <&gpiob 12 GPIO_ACTIVE_HIGH>;
			label = "LD";
		};
	};

	aliases {
		led0 = &led;
	};
};
```

## src/main.c
```c
#include <stddef.h>
#include <stdio.h>
#include <string.h>

#include <zephyr/kernel.h>
#include <zephyr/drivers/gpio.h>
#include <zephyr/drivers/uart.h>
#include <zephyr/device.h>
#include <zephyr/devicetree.h>
#include <zephyr/drivers/regulator.h>

#include <zephyr/drivers/sensor.h>

#include "at_client.h"
#include "zephyr/sys/printk.h"

#include <zephyr/logging/log.h>
LOG_MODULE_REGISTER(main, LOG_LEVEL_INF);

#define DELAY_MS 300

#define ESP8266_UART DEVICE_DT_GET(DT_NODELABEL(usart2))
#define BARO_SENSOR DEVICE_DT_GET(DT_NODELABEL(bmp280))

static const struct device *esp8266 = ESP8266_UART;
static const struct device *baro = BARO_SENSOR;

static struct at_client esp_client;
static char response_buf[1024];

int main(void)
{
	int ret;

	printk("Rocket Flight Logger firmware\n");

	if (!device_is_ready(esp8266)) {
		return 0;
	}

	if (!device_is_ready(baro)) {
		printk("BMP280 is not ready.\n");
		// return 0;
	}

	k_sleep(K_SECONDS(2));


	ret = at_client_init(&esp_client, esp8266);

	ret = at_client_send_command_sync(&esp_client, "AT", "OK", response_buf, sizeof(response_buf), 5000);

	if (ret < 0) {
		printk("ESP8266 isn't responding\n");
		return 0;
	}

	ret = at_client_send_command_sync(&esp_client, "ATE0", "OK", response_buf, sizeof(response_buf), 5000);

	while (1) {}

	return 0;
}
```

## include/at_client.h
```c
#ifndef AT_CLIENT_H_
#define AT_CLIENT_H_

#include <zephyr/kernel.h>
#include <zephyr/device.h>
#include <zephyr/drivers/uart.h>
#include <zephyr/sys/ring_buffer.h>

#include <stdint.h>
#include <stdbool.h>
#include <stddef.h>

#define AT_CLIENT_MAX_REPONSE_LEN 128
#define AT_CLIENT_RX_RING_BUF_SIZE 256
#define AT_CLIENT_CMD_TIMEOUT 5000
#define AT_CLIENT_MAX_COMMANDS 10

typedef void (*at_response_callback_t) (const char *response, void *user_data);

struct pending_command {
    const char *expected_response;
    at_response_callback_t callback;
    void *user_data;
    uint32_t start_time;
    bool is_pending;
    char *response_buffer;
    size_t response_len;
};

struct at_client {
    const struct device *uart_dev;
    struct ring_buf rx_ringbuf;
    uint8_t rx_buf[AT_CLIENT_RX_RING_BUF_SIZE];

    char rx_line[AT_CLIENT_MAX_REPONSE_LEN];
    size_t rx_line_len;

    struct k_work rx_work;
    struct k_work_delayable timeout_work;
    struct k_sem rx_sem;
    struct k_mutex lock;

    struct pending_command pending;

    at_response_callback_t urc_callback;
    void *urc_user_data;

    bool initialized;
};

int at_client_init(struct at_client *client, const struct device *uart_dev);

int at_client_send_command(struct at_client *client,
                        const char *command,
                        const char *expected_response,
                        at_response_callback_t callback,
                        void *user_data,
                        uint32_t timeout_ms);

int at_client_send_command_sync(struct at_client *client,
                            const char *command,
                            const char *expected_response,
                            char *response_buf,
                            size_t response_buf_size,
                            uint32_t timeout_ms);

void at_client_set_urc_callback(struct at_client *client,
                            at_response_callback_t callback,
                            void *user_data);

void at_client_cancel_pending(struct at_client *client);

void at_client_deinit(struct at_client *client);

#endif /* AT_CLIENT_H_ */
```
