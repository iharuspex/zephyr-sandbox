## CMakeLists.txt
```
cmake_minimum_required(VERSION 3.13.1)
find_package(Zephyr REQUIRED HINTS $ENV{ZEPHYR_BASE})

project(app-sandbox LANGUAGES C)

target_sources(app PRIVATE src/main.c
                            src/srv/pwm.c)

target_include_directories(app PRIVATE include)
```

## sample.yaml
```
# This file is provided so that the application can be compiled using Twister,
# the Zephyr testing tool. In this file, multiple combinations can be specified,
# so that you can easily test all of them locally or in CI.
sample:
  description: Example application
  name: example-application 
common:
  build_only: true
  integration_platforms:
    - stm32_min_dev
tests:
  app.default: {}
  app.debug:
    extra_overlay_confs:
      - debug.conf
```

## prj.conf
```kconfig
CONFIG_SENSOR=y
CONFIG_GPIO=y

CONFIG_MAIN_STACK_SIZE=4096
CONFIG_HEAP_MEM_POOL_SIZE=46336

# Networking
CONFIG_NETWORKING=y
CONFIG_NET_IPV4=y
CONFIG_NET_TCP=y
CONFIG_NET_SOCKETS=y

CONFIG_WIFI=y
CONFIG_WIFI_ESP32=y
CONFIG_NET_L2_WIFI_MGMT=y
CONFIG_NET_L2_ETHERNET=y
CONFIG_NET_MGMT=y
CONFIG_NET_MGMT_EVENT=y

CONFIG_HTTP_SERVER=y
CONFIG_HTTP_SERVER_MAX_CLIENTS=4

# CONFIG_MBEDTLS=y
CONFIG_POSIX_API=y
CONFIG_EVENTFD=y

CONFIG_FILE_SYSTEM=y
```

## src/main.c
```c
#include "zephyr/net/http/client.h"
#include "zephyr/net/wifi.h"
#include <string.h>
#include <zephyr/kernel.h>
#include <zephyr/drivers/gpio.h>
#include <zephyr/logging/log.h>
#include <zephyr/device.h>

#include <zephyr/net/wifi_mgmt.h>
#include <zephyr/net/net_if.h>
#include <zephyr/net/net_event.h>
#include <zephyr/net/http/server.h>

static void wifi_ap_start(void)
{
	struct net_if *iface = net_if_get_default();

	struct wifi_connect_req_params params = {
		.ssid = "ESP32_AP",
		.ssid_length = strlen("ESP32_AP"),
		.psk = "12345678",
		.psk_length = strlen("12345678"),
		.channel = 6,
		.security = WIFI_SECURITY_TYPE_PSK,
	};

	int ret = net_mgmt(NET_REQUEST_WIFI_AP_ENABLE, iface, &params, sizeof(params));

	if (ret) {
		printk("AP start failed: %d\n", ret);
	} else {
		printk("AP started: SSID=ESP32_AP\n");
	}
}

static int hello_handler(struct http_request *req, struct http_response *rsp, void *user_data)
{
	static const char html[] =
		"HTTP/1.1 200 OK\r\n"
		"Content-Type: text/html\r\n"
		"Connection: close\r\n"
		"\r\n"
		"<html>"
		"<head><title>Hello</title></head>"
		"<body><h1>Hello World</h1></body>"
		"</html>";

	return 0;
}





static void server_start(void)
{
	int ret = http_server_start();
	if (ret) {
		printk("HTTP server start failed: %d\n", ret);
	} else {
		printk("HTTP server started\n");
	}
}

int main(void)
{
	printk("ESP32-C3 AP + HTTP example\n");

	wifi_ap_start();
	server_start();

	return 0;
}
```

## include/pwm.h
```c
#ifndef APP_PWM_H
#define APP_PWM_H


#endif /* APP_PWM_H */
```
